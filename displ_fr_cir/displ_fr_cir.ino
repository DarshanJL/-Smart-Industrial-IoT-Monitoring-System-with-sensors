#include <WiFi.h>
#include <HTTPClient.h>
#include <WiFiClientSecure.h>
#include <Update.h>
#include <PubSubClient.h>
#include <ArduinoJson.h>
#include "aws_certs.h" // Your certificate file
#include <TFT_eSPI.h>        // Include the graphics library
#include "Display_ST7789.h"  // Your custom ST7789 initialization
#include "RGB_lamp.h"        // RGB lamp functions
#include <SPI.h>             // For SPI communication
#include <max6675.h>         // For MAX6675 (high temp)
#include <DHT.h>             // For DHT sensor

// WiFi Configuration
const char* ssid = "OPPOF";
const char* password = "darshan@123";

// AWS IoT Configuration
const char* awsEndpoint = "a2f5z2kpqmf02a-ats.iot.ap-south-1.amazonaws.com";
const int awsPort = 8883;
const char* mqttTopic = "REVA/INDUSTRIAL_MONITORING_SYSTEM/";

// Relay pins
const int RELAY_25 = 25;
const int RELAY_26 = 26;
const double TEMP_THRESHOLD = 150.0; // Temperature threshold for relay control

WiFiClientSecure net;
PubSubClient mqttClient(net);
bool updateInProgress = false;
String clientId = "convin-aws-" + String(random(0xffff), HEX); // Add random ID to avoid conflicts

// Debug counters
unsigned long lastReconnectAttempt = 0;
const unsigned long reconnectInterval = 5000;
unsigned long lastStatusPublish = 0;
const unsigned long statusPublishInterval = 30000;

const int BUFFER_SIZE = 10; // Size of the circular buffer
String messageBuffer[BUFFER_SIZE]; // Message storage
int writeIndex = 0;
int readIndex = 0;
int messageCount = 0;

// Display setup
TFT_eSPI tft = TFT_eSPI();

// Temperature sensor setup (MAX6675)
const int8_t TEMP_SCK = 14;
const int8_t TEMP_CS  = 13;   
const int8_t TEMP_SO  = 27;  
MAX6675 thermocouple(TEMP_SCK, TEMP_CS, TEMP_SO);

// Vibration sensor setup
#define VIBRATION_PIN 32
unsigned long lastVibrationTime = 0;
int vibrationCount = 0;
bool vibrationDetected = false;

// Humidity sensor setup
#define DHTPIN 26
#define DHTTYPE DHT11
DHT dht(DHTPIN, DHTTYPE);

// System variables
unsigned long lastUpdateTime = 0;
const long updateInterval = 2000; // Update every 2 seconds
unsigned long lastWifiCheckTime = 0;
const long wifiCheckInterval = 5000; // Check WiFi every 5 seconds

// Previous values for comparison
double prevTempC = -1000;
float prevHumidity = -1000;
int prevVibrationCount = -1;
bool prevWifiStatus = false;

// Colors
#define BACKGROUND_COLOR TFT_BLACK
#define HEADER_COLOR 0x2104       // Dark gray
#define TEXT_COLOR TFT_WHITE
#define WARNING_COLOR TFT_RED
#define VALUE_COLOR TFT_YELLOW
#define OK_COLOR TFT_GREEN
#define TEMP_COLOR 0xFB28         // Orange
#define VIB_COLOR 0x9D5D          // Yellow
#define HUM_COLOR 0x34BF          // Blue
#define SYS_COLOR 0x05E0          // Green
#define WIFI_CONNECTED_COLOR TFT_GREEN
#define WIFI_DISCONNECTED_COLOR TFT_RED

// Parameter thresholds
#define TEMP_WARNING 500.0
#define HUM_WARNING 80.0

// Connection status images
const uint16_t wifiConnectedImg[] PROGMEM = {
  // Simple WiFi connected icon (32x32)
	0xffff, 0xffff, 0xffff, 0xffff, 0xffff, 0xffff, 0xffff, 0xffff, 0xffff, 0xffff, 0xffff, 0xffff, 0xffff, 0xffff, 0xffff, 0xffff, 
	0xffff, 0xffff, 0xffff, 0xffff, 0xffff, 0xffff, 0xffff, 0xffff, 0xffff, 0xffff, 0xffff, 0xffff, 0xffff, 0xffff, 0xffff, 0xffff, 
	0xffff, 0xffff, 0xffff, 0xffff, 0xffff, 0xffff, 0xffff, 0xffff, 0xffff, 0xffff, 0xffff, 0xffff, 0xffff, 0xffff, 0xffff, 0xffff, 
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	0xffff, 0xffff, 0xffff, 0xffff, 0xffff, 0xffff, 0xffff, 0xffff, 0xffff, 0xffff, 0xffff, 0xffff, 0xffff, 0xffff, 0xffff, 0xffff
};

const uint16_t wifiDisconnectedImg[] PROGMEM = {
  // Simple WiFi disconnected icon (32x32)
	0x528a, 0x0000, 0xa534, 0xffff, 0xffff, 0xffff, 0xffff, 0xffff, 0xffff, 0xffff, 0xffff, 0xffff, 0xffff, 0xffff, 0xffff, 0xffff, 
	0xffff, 0xffff, 0xffff, 0xffff, 0xffff, 0xffff, 0xffff, 0xffff, 0xffff, 0xffff, 0xffff, 0xffff, 0xffff, 0xffff, 0xffff, 0xffff, 
	0x0000, 0x0000, 0x0000, 0xa514, 0xffdf, 0xffff, 0xffff, 0xffff, 0xffff, 0xffff, 0xffff, 0xffff, 0xffff, 0xffff, 0xffff, 0xffff, 
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	0xffff, 0xffff, 0xffff, 0xffff, 0xffff, 0xffff, 0xffff, 0xffff, 0xffff, 0xffff, 0xffff, 0xffff, 0xffff, 0xad55, 0x0000, 0x528a
};


void setup() {
  Serial.begin(115200);
  while (!Serial) delay(10);
  
  // Initialize relays
  pinMode(RELAY_25, OUTPUT);
  pinMode(RELAY_26, OUTPUT);
  digitalWrite(RELAY_25, HIGH); // Start with relays off (assuming HIGH is off)
  digitalWrite(RELAY_26, HIGH);
  
  // Initialize display
  LCD_Init();
  Set_Backlight(90);
  tft.begin();
  tft.setRotation(7);
  tft.setSwapBytes(true);
  initializeDisplay();
  
  // Initialize RGB lamp
  // RGB_Lamp_Init();
  
  // Initialize temperature sensor
  Serial.println("Initializing temperature sensor...");
  
  // Initialize vibration sensor
  pinMode(VIBRATION_PIN, INPUT);
  Serial.println("Initializing vibration sensor...");
  
  // Initialize humidity sensor
  dht.begin();
  Serial.println("Initializing humidity sensor...");
  
  // Connect to WiFi and AWS IoT
  Serial.println("\nStarting Device...");
  printChipInfo();
  
  connectToWiFi();
  setupAWSIoT();
  
  if (mqttClient.connected()) {
    mqttPublishStatus("Device booted and ready");
    subscribeToTopics();
  }
}

void loop() {
  unsigned long currentMillis = millis();
  
  // Handle RGB lamp
  // RGB_Lamp_Loop(2);
  
  // Check for vibration
  if (digitalRead(VIBRATION_PIN)) {
    if (!vibrationDetected) {
      vibrationDetected = true;
      vibrationCount++;
      lastVibrationTime = millis();
      // Immediately update vibration count when detected
      updateDisplay(true);
    }
  } else {
    vibrationDetected = false;
  }
  
  // Update readings at regular intervals
  if (millis() - lastUpdateTime >= updateInterval) {
    lastUpdateTime = millis();
    updateDisplay(false);
    printAndPublishSensorData();
  }
  
  // Check WiFi status periodically
  if (millis() - lastWifiCheckTime >= wifiCheckInterval) {
    lastWifiCheckTime = millis();
    bool currentWifiStatus = (WiFi.status() == WL_CONNECTED);
    if (currentWifiStatus != prevWifiStatus) {
      prevWifiStatus = currentWifiStatus;
      updateDisplay(false); // Force display update to show new WiFi status
    }
  }
  
  // Maintain MQTT connection
  if (!mqttClient.connected()) {
    if (currentMillis - lastReconnectAttempt >= reconnectInterval) {
      lastReconnectAttempt = currentMillis;
      Serial.println("Attempting MQTT reconnection...");
      reconnectAWSIoT();
    }
  } else {
    // Regular status updates when connected
    if (currentMillis - lastStatusPublish >= statusPublishInterval) {
      lastStatusPublish = currentMillis;
      mqttPublishStatus("Device heartbeat - Free memory: " + String(ESP.getFreeHeap()));
    }
  }

  mqttClient.loop();
  
  
  delay(100);
}

// Display functions
void initializeDisplay() {
  tft.fillScreen(BACKGROUND_COLOR);
  showSplashScreen();
  
  // Draw static elements
  tft.fillRect(0, 0, tft.width(), 30, HEADER_COLOR);
  centerText("INDUSTRIAL MONITOR", 10, 2, TEXT_COLOR, HEADER_COLOR);
  tft.fillScreen(TFT_BLACK);
  
  // Initialize parameter boxes with empty values
  int boxWidth = 320 / 2 - 5;
  int boxHeight = 172 / 2 - 5;
  
  drawParameterBox(5, 35, boxWidth, boxHeight, "TEMPERATURE", -999, "°C", TEMP_COLOR, false);
  drawParameterBox(boxWidth + 10, 35, boxWidth, boxHeight, "VIBRATION", -999, "", VIB_COLOR, false);
  drawParameterBox(5, boxHeight + 40, boxWidth, boxHeight, "HUMIDITY", -999, "%", HUM_COLOR, false);
  drawParameterBox(boxWidth + 10, boxHeight + 40, boxWidth, boxHeight, "SYSTEM", -999, "%", SYS_COLOR, false);
  
  // Draw WiFi status area
  drawWifiStatus();
}

void showSplashScreen() {
  tft.fillScreen(HEADER_COLOR);
  centerText("INDUSTRIAL", 60, 3, TEXT_COLOR, HEADER_COLOR);
  centerText("MONITORING", 100, 3, TEXT_COLOR, HEADER_COLOR);
  centerText("SYSTEM", 140, 3, TEXT_COLOR, HEADER_COLOR);
  delay(1500);
}

void updateDisplay(bool vibrationOnly) {
  // Get sensor readings
  double tempC = thermocouple.readCelsius();
  float humidity = dht.readHumidity();
  
  // Control relays based on temperature
  if (tempC >= TEMP_THRESHOLD) {
    digitalWrite(RELAY_25, LOW); // Turn relays on (assuming LOW is on)
    digitalWrite(RELAY_26, LOW);
  } else {
    digitalWrite(RELAY_25, HIGH); // Turn relays off
    digitalWrite(RELAY_26, HIGH);
  }
  
  // Calculate box dimensions
  int boxWidth = 320 / 2 - 5;
  int boxHeight = 172 / 2 - 5;
  
  // Only update what has changed
  if (!vibrationOnly) {
    // Update temperature if changed
    if (abs(tempC - prevTempC) > 0.1) {
      bool warning = tempC > TEMP_WARNING;
      drawParameterBox(5, 35, boxWidth, boxHeight, "TEMPERATURE", tempC, "'C", TEMP_COLOR, warning);
      prevTempC = tempC;
    }
    
    // Update humidity if changed
    if (abs(humidity - prevHumidity) > 0.1) {
      bool warning = humidity > HUM_WARNING;
      drawParameterBox(5, boxHeight + 40, boxWidth, boxHeight, "HUMIDITY", humidity, "%", HUM_COLOR, warning);
      prevHumidity = humidity;
    }
    
    // Always update system status
    drawParameterBox(boxWidth + 10, boxHeight + 40, boxWidth, boxHeight, "SYSTEM", 100, "%", SYS_COLOR, false);
  }
  
  // Update vibration if changed or forced
  if (vibrationCount != prevVibrationCount || vibrationOnly) {
    drawParameterBox(boxWidth + 10, 35, boxWidth, boxHeight, "VIBRATION", vibrationCount, "", VIB_COLOR, vibrationDetected);
    prevVibrationCount = vibrationCount;
  }
  
  // Update WiFi status
  drawWifiStatus();
}

void drawWifiStatus() {
  bool wifiConnected = (WiFi.status() == WL_CONNECTED);
  uint16_t wifiColor = wifiConnected ? WIFI_CONNECTED_COLOR : WIFI_DISCONNECTED_COLOR;
  
  // Draw WiFi icon in the center of the display
  int iconX = tft.width() / 2 - 16;
  int iconY = tft.height() / 2 - 16;
  
  tft.fillRect(iconX, iconY, 32, 32, BACKGROUND_COLOR);
  // tft.drawBitmap(iconX, iconY, wifiConnected ? wifiConnectedImg : wifiDisconnectedImg, 16, 16, wifiColor);
  tft.pushImage(iconX, iconY, 32, 32, wifiConnected ? wifiConnectedImg : wifiDisconnectedImg);

  
  // Draw status text below the icon
  tft.setTextSize(1);
  tft.setTextColor(wifiColor, BACKGROUND_COLOR);
  tft.setTextDatum(TC_DATUM);
  // tft.drawString(wifiConnected ? "Connected" : "Disconnected", tft.width() / 2, iconY + 18);
}

void drawParameterBox(int x, int y, int w, int h, const char* label, float value, const char* unit, uint16_t color, bool warning) {
  // Draw the box (only if value is not -999)
  if (value > -900) {
    uint16_t boxColor = warning ? WARNING_COLOR : color;
    tft.fillRoundRect(x, y, w, h, 5, boxColor);
    
    // Draw label
    tft.setTextColor(TFT_WHITE, boxColor);
    tft.setTextSize(1);
    tft.setTextDatum(TC_DATUM); // Top center alignment
    tft.drawString(label, x + w/2, y + 10);
    
    // Draw value
    tft.setTextSize(3);
    String valueStr;
    if (strcmp(label, "VIBRATION") == 0) {
      valueStr = String((int)value);
    } else if (value < -900) {
      valueStr = "--";
    } else {
      valueStr = String(value, 1) + unit;
    }
    tft.drawString(valueStr, x + w/2, y + h/2 - 10);
    
    // Draw status if warning
    if (warning) {
      tft.setTextSize(2);
      if (strcmp(label, "TEMPERATURE") == 0) {
        tft.drawString("HIGH TEMP!", x + w/2, y + h - 30);
      } else if (strcmp(label, "VIBRATION") == 0) {
        tft.drawString("DETECTED!", x + w/2, y + h - 30);
      } else if (strcmp(label, "HUMIDITY") == 0) {
        tft.drawString("HIGH HUMID!", x + w/2, y + h - 30);
      }
    }
  }
}

void centerText(const char *text, int y, int textSize, uint16_t color, uint16_t bgColor) {
  tft.setTextSize(textSize);
  tft.setTextColor(color, bgColor);
  int textWidth = tft.textWidth(text);
  int x = (tft.width() - textWidth) / 2;
  tft.setCursor(x, y);
  tft.println(text);
}

// AWS IoT Functions
void printChipInfo() {
  Serial.println("\nDevice Info:");
  Serial.printf("Chip Model: %s\n", ESP.getChipModel());
  Serial.printf("Chip Cores: %d\n", ESP.getChipCores());
  Serial.printf("Flash Size: %d MB\n", ESP.getFlashChipSize() / (1024 * 1024));
  Serial.printf("Free Heap: %d bytes\n", ESP.getFreeHeap());
  Serial.printf("WiFi MAC: %s\n", WiFi.macAddress().c_str());
}

void connectToWiFi() {
  Serial.print("\nConnecting to WiFi: ");
  Serial.println(ssid);
  
  WiFi.disconnect(true);
  WiFi.begin(ssid, password);
  WiFi.setAutoReconnect(true);
  WiFi.persistent(true);
  
  unsigned long startTime = millis();
  while (WiFi.status() != WL_CONNECTED && millis() - startTime < 20000) {
    delay(500);
    Serial.print(".");
  }
  
  if (WiFi.status() != WL_CONNECTED) {
    Serial.println("\nFailed to connect to WiFi");
    ESP.restart();
  }
  
  Serial.println("\nWiFi connected");
  Serial.print("IP address: ");
  Serial.println(WiFi.localIP());
  Serial.print("Signal strength: ");
  Serial.print(WiFi.RSSI());
  Serial.println(" dBm");
}

void setupAWSIoT() {
  Serial.println("\nConfiguring AWS IoT connection...");
  
  // Set certificates (these don't return success/failure)
  net.setCACert(awsRootCA);
  net.setCertificate(awsClientCert);
  net.setPrivateKey(awsPrivateKey);

  // For debugging - print certificate info
  Serial.println("Attempting to connect to AWS IoT endpoint...");
  
  mqttClient.setServer(awsEndpoint, awsPort);
  mqttClient.setCallback(mqttCallback);
  mqttClient.setBufferSize(2048);
  mqttClient.setKeepAlive(60);
  mqttClient.setSocketTimeout(30);
}

void printSSLConnectionError() {
  char errorBuf[256];
  int sslError = net.lastError(errorBuf, sizeof(errorBuf));
  
  Serial.print("SSL Error: ");
  if (sslError) {
    Serial.print(sslError);
    Serial.print(" - ");
    Serial.println(errorBuf);
  } else {
    Serial.println("No error information available");
  }
}

void reconnectAWSIoT() {
  Serial.println("Attempting to connect to AWS IoT...");
  
  if (WiFi.status() != WL_CONNECTED) {
    Serial.println("WiFi not connected, reconnecting...");
    connectToWiFi();
    delay(1000); // Give WiFi time to stabilize
  }

  if (mqttClient.connect(clientId.c_str())) {
    Serial.println("AWS IoT Connected!");
    subscribeToTopics();
    mqttPublishStatus("Connected to AWS IoT");
  } else {
    Serial.print("AWS IoT Connection Failed, rc=");
    Serial.print(mqttClient.state());
    Serial.println(" (see below for error codes)");
    printMQTTError(mqttClient.state());
    
    // Print SSL errors if available
    printSSLConnectionError();
    
    Serial.println("Retrying in 5 seconds...");
    delay(5000);
  }
}

void subscribeToTopics() {
  bool sub1 = mqttClient.subscribe(mqttTopic);
  Serial.printf("Subscription to %s %s\n", mqttTopic, sub1 ? "successful" : "failed");
}

// void mqttCallback(char* topic, byte* payload, unsigned int length) {
//   Serial.print("\nMessage arrived [");
//   Serial.print(topic);
//   Serial.print("] Length: ");
//   Serial.println(length);
  
//   // Create null-terminated string
//   char message[length + 1];
//   memcpy(message, payload, length);
//   message[length] = '\0';
  
//   Serial.print("Payload: ");
//   Serial.println(message);

//   // Parse JSON for commands
//   StaticJsonDocument<1024> doc;
//   DeserializationError error = deserializeJson(doc, message);
  
//   if (error) {
//     Serial.print("JSON error: ");
//     Serial.println(error.c_str());
//     mqttPublishStatus("JSON error: " + String(error.c_str()));
//     return;
//   }

//   // Handle commands here if needed
//   if (doc.containsKey("command")) {
//     const char* command = doc["command"];
//     Serial.print("Received command: ");
//     Serial.println(command);
//     mqttPublishStatus("Command received: " + String(command));
//   }
// }
void mqttCallback(char* topic, byte* payload, unsigned int length) {
  Serial.print("\nMessage arrived [");
  Serial.print(topic);
  Serial.print("] Length: ");
  Serial.println(length);

  // Convert payload to null-terminated string
  char message[length + 1];
  memcpy(message, payload, length);
  message[length] = '\0';

  Serial.print("Payload: ");
  Serial.println(message);

  // Store in circular buffer
  messageBuffer[writeIndex] = String(message);
  writeIndex = (writeIndex + 1) % BUFFER_SIZE;

  if (messageCount < BUFFER_SIZE) {
    messageCount++;
  } else {
    // Overwriting oldest message
    readIndex = (readIndex + 1) % BUFFER_SIZE;
  }
}



void printAndPublishSensorData() {
  double tempC = thermocouple.readCelsius();
  float humidity = dht.readHumidity();
  float dhtTemp = dht.readTemperature();
  
  if (tempC > TEMP_WARNING) {
    Serial.println("WARNING: High temperature detected!");
  }
  if (vibrationDetected) {
    Serial.println("WARNING: Vibration detected!");
  }
  if (humidity > HUM_WARNING) {
    Serial.println("WARNING: High humidity detected!");
  }
  
  // Publish to MQTT if connected
  if (mqttClient.connected()) {
    StaticJsonDocument<1024> doc;
    doc["temperature"] = tempC;
    doc["humidity"] = isnan(humidity) ? 0 : humidity;
    doc["vibration_count"] = vibrationCount;
    doc["dht_temperature"] = isnan(dhtTemp) ? 0 : dhtTemp;
    doc["FAN"] = digitalRead(RELAY_25) == LOW ? "ON" : "OFF";
    // doc["relay_26"] = digitalRead(RELAY_26) == LOW ? "ON" : "OFF";
    doc["System"] = "100%";
    
    char output[1024];
    serializeJson(doc, output);
    mqttClient.publish(mqttTopic, output);
  }
}

void mqttPublishStatus(String message) {
  Serial.print("Publishing status: ");
  Serial.println(message);
  
  if (mqttClient.connected()) {
    if (!mqttClient.publish(mqttTopic, message.c_str())) {
      Serial.println("Publish failed!");
    }
  } else {
    Serial.println("Cannot publish - MQTT disconnected");
  }
}

void printDebugInfo() {
  Serial.println("\n=== System Status ===");
  Serial.printf("WiFi Status: %s\n", WiFi.status() == WL_CONNECTED ? "Connected" : "Disconnected");
  Serial.printf("MQTT Status: %s\n", mqttClient.connected() ? "Connected" : "Disconnected");
  Serial.printf("Free Heap: %d bytes\n", ESP.getFreeHeap());
  Serial.printf("Uptime: %lu seconds\n", millis() / 1000);
  Serial.println("=====================");
}

void printMQTTError(int state) {
  Serial.print("MQTT Error: ");
  switch (state) {
    case MQTT_CONNECTION_TIMEOUT:     Serial.println("Connection timeout"); break;
    case MQTT_CONNECTION_LOST:        Serial.println("Connection lost"); break;
    case MQTT_CONNECT_FAILED:         Serial.println("Connect failed"); break;
    case MQTT_DISCONNECTED:           Serial.println("Disconnected"); break;
    case MQTT_CONNECT_BAD_PROTOCOL:   Serial.println("Bad protocol"); break;
    case MQTT_CONNECT_BAD_CLIENT_ID:  Serial.println("Bad client ID"); break;
    case MQTT_CONNECT_UNAVAILABLE:    Serial.println("Unavailable"); break;
    case MQTT_CONNECT_BAD_CREDENTIALS:Serial.println("Bad credentials"); break;
    case MQTT_CONNECT_UNAUTHORIZED:   Serial.println("Unauthorized"); break;
    default:                          Serial.println("Unknown error"); break;
  }
}